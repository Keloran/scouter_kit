## CMakeLists.txt
```
cmake_minimum_required(VERSION 3.20.0)
find_package(Zephyr REQUIRED HINTS $ENV{ZEPHYR_BASE})
project(g1min)
target_sources(app PRIVATE src/main.c src/g1_netcore.c)
```

## prj.conf
```kconfig
# g1min: smallest app that is a valid G1 app-core image for the emulator tests:
# MCUboot-signed, BLE through the stock net core, MCUmgr SMP DFU over BLE.
CONFIG_BOOTLOADER_MCUBOOT=y
CONFIG_MCUBOOT_IMGTOOL_SIGN_VERSION="0.1.0+0"
CONFIG_UPDATEABLE_IMAGE_NUMBER=2
CONFIG_NRF53_UPGRADE_NETWORK_CORE=y
CONFIG_ADD_MCUBOOT_MEDIATE_SIM_FLASH_DTS=y

CONFIG_BT=y
CONFIG_BT_PERIPHERAL=y
CONFIG_BT_DEVICE_NAME="G1min"
CONFIG_BT_MAX_CONN=1
CONFIG_NCS_SAMPLE_MCUMGR_BT_OTA_DFU=y
CONFIG_MCUMGR_GRP_OS_ECHO=y

CONFIG_IPC_SERVICE=y
CONFIG_IPC_SERVICE_BACKEND_RPMSG_NUM_ENDPOINTS_PER_INSTANCE=2

CONFIG_LOG=y
CONFIG_LOG_MODE_IMMEDIATE=y
CONFIG_PRINTK=y
CONFIG_MAIN_STACK_SIZE=4096
CONFIG_SYSTEM_WORKQUEUE_STACK_SIZE=2048
CONFIG_RESET_ON_FATAL_ERROR=y
```

## app.overlay
```dts
/* G1 external flash: Macronix MX25U25645G (32 MiB, JEDEC c2 25 39) on the DK's QSPI node. */
/ {
	chosen {
		nordic,pm-ext-flash = &mx25r64;
	};
};

&mx25r64 {
	jedec-id = [c2 25 39];
	size = <268435456>;
	/delete-property/ sfdp-bfp;
};
```

## dk_flash.overlay
```dts
/* nRF5340 DK rehearsal variant: restore the DK's own MX25R64 (8 MiB, JEDEC c2 28 17).
 * Applied last (EXTRA_DTC_OVERLAY_FILE), after the G1 flash override. */
&mx25r64 {
	jedec-id = [c2 28 17];
	size = <67108864>;
};
```

## src/main.c
```c
#include <zephyr/kernel.h>
#include <zephyr/bluetooth/bluetooth.h>
#include <zephyr/bluetooth/conn.h>
#include <zephyr/logging/log.h>
#include "g1_netcore.h"

LOG_MODULE_REGISTER(g1min, LOG_LEVEL_INF);

#define SMP_SVC_UUID 0x84, 0xaa, 0x60, 0x74, 0x52, 0x8a, 0x8b, 0x86, \
		     0xd3, 0x4c, 0xb7, 0x1d, 0x1d, 0xdc, 0x53, 0x8d

static const struct bt_data ad[] = {
	BT_DATA_BYTES(BT_DATA_FLAGS, (BT_LE_AD_GENERAL | BT_LE_AD_NO_BREDR)),
	BT_DATA(BT_DATA_NAME_COMPLETE, CONFIG_BT_DEVICE_NAME, sizeof(CONFIG_BT_DEVICE_NAME) - 1),
};

static const struct bt_data sd[] = {
	BT_DATA_BYTES(BT_DATA_UUID128_ALL, SMP_SVC_UUID),
};

static void adv_restart(struct k_work *work);
static K_WORK_DELAYABLE_DEFINE(adv_work, adv_restart);

static void connected(struct bt_conn *conn, uint8_t err)
{
	LOG_INF("connected (err %u)", err);
}

static void disconnected(struct bt_conn *conn, uint8_t reason)
{
	LOG_INF("disconnected (reason 0x%02x)", reason);
	k_work_schedule(&adv_work, K_MSEC(200));
}

BT_CONN_CB_DEFINE(conn_cb) = {
	.connected = connected,
	.disconnected = disconnected,
};

/* Advertising restarts only when not connected (BT_MAX_CONN is 1); a failed start is retried. */
static void adv_restart(struct k_work *work)
{
	int err = bt_le_adv_start(BT_LE_ADV_CONN, ad, ARRAY_SIZE(ad), sd, ARRAY_SIZE(sd));

	if (err && err != -EALREADY) {
		LOG_ERR("advertising failed: %d, retrying", err);
		k_work_schedule(&adv_work, K_SECONDS(1));
	}
}

int main(void)
{
	int err;

	LOG_INF("g1min %s booting", CONFIG_MCUBOOT_IMGTOOL_SIGN_VERSION);
	err = g1_netcore_handshake(1, 34, 0x41, 0x42);
	if (err) {
		LOG_ERR("net core handshake failed: %d", err);
	}
	for (int i = 0; i < 5; i++) {
		k_sleep(K_MSEC(800));
		err = bt_enable(NULL);
		if (!err || err == -EALREADY) {
			break;
		}
		LOG_WRN("bt_enable: %d, retrying", err);
	}
	if (err && err != -EALREADY) {
		LOG_ERR("bluetooth unavailable");
		return 0;
	}
	k_work_schedule(&adv_work, K_NO_WAIT);
	LOG_INF("advertising as %s, SMP ready", CONFIG_BT_DEVICE_NAME);
	return 0;
}
```

## src/g1_netcore.c
```c
/*
 * Handshake expected by the stock G1 net-core image (see g1-fw docs/g1-netcore-ipc-protocol.md):
 * the app must bind an RPMsg endpoint named "ipc0" and answer the net core's role request
 * (01 02 ...) with sub-service 1 / sub-command 0, otherwise the net core never registers
 * "nrf_bt_hci" and reboots itself after ~6 s.
 */
#include <zephyr/kernel.h>
#include <zephyr/device.h>
#include <zephyr/ipc/ipc_service.h>
#include <zephyr/logging/log.h>
#include "g1_netcore.h"

LOG_MODULE_REGISTER(g1_netcore, LOG_LEVEL_INF);

static struct ipc_ept ept;
static K_SEM_DEFINE(bound_sem, 0, 1);
static K_SEM_DEFINE(role_req_sem, 0, 1);
static K_SEM_DEFINE(addr_sem, 0, 1);

static void bound_cb(void *priv)
{
	k_sem_give(&bound_sem);
}

static void received_cb(const void *data, size_t len, void *priv)
{
	const uint8_t *d = data;

	if (len < 2 || d[0] != 0x01) {
		return;
	}
	switch (d[1]) {
	case 0x02:
		k_sem_give(&role_req_sem);
		break;
	case 0x03:
		if (len >= 8) {
			LOG_INF("net core BD_ADDR %02x:%02x:%02x:%02x:%02x:%02x",
				d[7], d[6], d[5], d[4], d[3], d[2]);
		}
		k_sem_give(&addr_sem);
		break;
	case 0x06:
		LOG_INF("net core build %.*s", (int)MIN(len - 2, 30), (const char *)&d[2]);
		break;
	default:
		break;
	}
}

static struct ipc_ept_cfg ept_cfg = {
	.name = "ipc0",
	.cb = {
		.bound = bound_cb,
		.received = received_cb,
	},
};

int g1_netcore_handshake(uint8_t role, uint8_t esb_channel, uint8_t esb_master, uint8_t esb_slave)
{
	const struct device *ipc = DEVICE_DT_GET(DT_NODELABEL(ipc0));
	uint8_t msg[16] = {0x01, 0x00, role, 0x00, esb_channel, esb_master, esb_slave};
	int err;

	err = ipc_service_open_instance(ipc);
	if (err && err != -EALREADY) {
		LOG_ERR("open instance: %d", err);
		return err;
	}
	err = ipc_service_register_endpoint(ipc, &ept, &ept_cfg);
	if (err) {
		LOG_ERR("register ipc0: %d", err);
		return err;
	}
	if (k_sem_take(&bound_sem, K_SECONDS(5))) {
		LOG_ERR("ipc0 not bound");
		return -ETIMEDOUT;
	}
	if (k_sem_take(&role_req_sem, K_SECONDS(5))) {
		LOG_ERR("no role request from net core");
		return -ETIMEDOUT;
	}
	err = ipc_service_send(&ept, msg, sizeof(msg));
	if (err < 0) {
		LOG_ERR("role reply: %d", err);
		return err;
	}
	if (k_sem_take(&addr_sem, K_SECONDS(3))) {
		LOG_WRN("no BD_ADDR report after role reply");
	}
	LOG_INF("net core accepted role %u", role);
	return 0;
}
```

## src/g1_netcore.h
```c
#ifndef G1_NETCORE_H_
#define G1_NETCORE_H_

#include <stdint.h>

int g1_netcore_handshake(uint8_t role, uint8_t esb_channel, uint8_t esb_master, uint8_t esb_slave);

#endif
```
